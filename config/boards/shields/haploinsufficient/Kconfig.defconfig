## config/boards/shields/haploinsufficient/Kconfig.defconfig
```kconfig
# Copyright (c) 2022 The ZMK Contributors
# SPDX-License-Identifier: MIT

if SHIELD_HAPLO-INS_LEFT

config ZMK_KEYBOARD_NAME
	default "haplo-ins"

config ZMK_SPLIT_BLE_ROLE_CENTRAL
	default y

endif

if SHIELD_HAPLO-INS_LEFT || SHIELD_HAPLO-INS_RIGHT

config ZMK_SPLIT
	default y

endif
```

## config/boards/shields/haploinsufficient/Kconfig.shield
```kconfig
# Copyright (c) 2022 The ZMK Contributors
# SPDX-License-Identifier: MIT

config SHIELD_HAPLO-INS_LEFT
	def_bool $(shields_list_contains,haplo-ins_left)

config SHIELD_HAPLO-INS_RIGHT
	def_bool $(shields_list_contains,haplo-ins_right)
```

## config/west.yml
```yaml
manifest:
  remotes:
    - name: zmkfirmware
      url-base: https://github.com/zmkfirmware
    - name: eiconoklastes
      url-base: https://github.com/eiconoklastes
  projects:
    - name: zmk
      remote: andrewjrae
      revision: global-quick-tap
      import: app/west.yml
  self:
    path: config
```

## zmk-config/config/boards/shields/rae_dux/Kconfig.defconfig
```kconfig
# Copyright (c) 2022 The ZMK Contributors
# SPDX-License-Identifier: MIT

if SHIELD_HAPLOINSUFFICIENT_LEFT

config ZMK_KEYBOARD_NAME
	default "haploinsufficient"

config ZMK_SPLIT_BLE_ROLE_CENTRAL
	default y

endif

if SHIELD_HAPLOINSUFFICIENT_LEFT || SHIELD_HAPLOINSUFFICIENT_RIGHT

config ZMK_SPLIT
	default y

endif
```

## zmk-config/config/west.yml
```yaml
manifest:
  remotes:
    - name: zmkfirmware
      url-base: https://github.com/zmkfirmware
    - name: andrewjrae
      url-base: https://github.com/andrewjrae
  projects:
    - name: zmk
      remote: andrewjrae
      revision: global-quick-tap
      import: app/west.yml
  self:
    path: config
```
